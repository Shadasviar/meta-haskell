## conf/layer.conf
```bitbake
BBPATH  .= ":${LAYERDIR}"
BBFILES += "\
  ${LAYERDIR}/recipes-*/*/*.bb \
  ${LAYERDIR}/recipes-*/*/*.bbappend \
"

BBFILE_COLLECTIONS         += "haskell"
BBFILE_PATTERN_haskell      = "^${LAYERDIR}/"
BBFILE_PRIORITY_haskell     = "20"
LAYERVERSION_haskell        = "1"
LAYERDEPENDS_haskell        = ""
LAYERSERIES_COMPAT_haskell  = "scarthgap"

HOSTTOOLS += "ghc ghc-pkg alex happy"
```
